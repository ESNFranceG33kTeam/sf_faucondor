## src/FaucondorBundle/Resources/config/routing/board.yml
```yaml
board:
    path:     /
    defaults: { _controller: "FaucondorBundle:Board:index" }

board_show:
    path:     /{id}/show
    defaults: { _controller: "FaucondorBundle:Board:show" }

board_new:
    path:     /new
    defaults: { _controller: "FaucondorBundle:Board:new" }

board_create:
    path:     /create
    defaults: { _controller: "FaucondorBundle:Board:create" }
    methods:  POST

board_edit:
    path:     type/{type}/{id}/edit/
    defaults: { _controller: "FaucondorBundle:Board:edit" }

board_update:
    path:     type/{type}/{id}/update
    defaults: { _controller: "FaucondorBundle:Board:update" }
    methods:  [POST, PUT]

board_delete:
    path:     /{id}/delete
    defaults: { _controller: "FaucondorBundle:Board:delete" }
```
